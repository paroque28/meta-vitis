## conf/layer.conf
```bitbake
# We have a conf and classes directory, add to BBPATH
BBPATH .= ":${LAYERDIR}"

# We have recipes-* directories, add to BBFILES
BBFILES += "${LAYERDIR}/recipes-*/*/*.bb \
            ${LAYERDIR}/recipes-*/*/*.bbappend"

BBFILE_COLLECTIONS += "meta-vitis"
BBFILE_PATTERN_meta-vitis = "^${LAYERDIR}/"
BBFILE_PRIORITY_meta-vitis = "7"

LAYERDEPENDS_meta-vitis = "core"
LAYERSERIES_COMPAT_meta-vitis = "zeus wrl dunfell"
```
